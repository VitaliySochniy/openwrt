// SPDX-License-Identifier: (GPL-2.0 OR MIT)

/dts-v1/;
/plugin/;

/ {
	compatible = "cudy,tr3000-v1-ubootmod", "mediatek,mt7981";

	fragment@0 {
		target-path = "/";

		__overlay__ {
			model = "OrayBox X1Pro";
			compatible = "oraybox,x1pro", "mediatek,mt7981";
		};
	};

	fragment@1 {
		target = <&gmac0>;

		__overlay__ {
			nvmem-cells = <&macaddr_factory_e000 1>;
			nvmem-cell-names = "mac-address";
		};
	};

	fragment@2 {
		target = <&gmac1>;

		__overlay__ {
			nvmem-cells = <&macaddr_factory_e000 0>;
			nvmem-cell-names = "mac-address";
		};
	};
};
